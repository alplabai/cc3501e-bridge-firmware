/*
 * Copyright 2026 Alp Lab AB
 * SPDX-License-Identifier: Apache-2.0
 */
// @cliArgs --board /ti/boards/LP_EM_CC35X1 --rtos freertos

/*
 * cc3501e-bridge ti-build board file -- WI-FI HOST variant (-WifiHostDriver).
 *
 * DERIVED FROM cc3501e_aen.syscfg (the default/bench-validated board file).
 * The SPI-peripheral (CONFIG_SPI_0) + kernel blocks below are a VERBATIM copy
 * of that file -- cc3501e_aen.syscfg remains the source of truth for the
 * inter-chip SPI pinout + the bench HW notes; keep this block in sync if it
 * changes there.  The deltas are ADDITIONS only, in declaration order below:
 * the SPI1 host-passthrough CONTROLLER (CONFIG_SPI_1, protocol v6 -- absent
 * from the default board file, so that image has SPI_count 1 and no
 * CONFIG_SPI_1 symbol), the internal-temperature ADC channel, and the UART2
 * instance (CONFIG_UART2_0), which the CC35xx Wi-Fi host integration's
 * console/log glue requires:
 * adaptation/uart_term.c opens UART2_open(CONFIG_UART2_0,...) and the wifi
 * libs reference Report(); without a UART2 instance UART2_config[]/UART2_count
 * are absent and the link fails.  A SEPARATE variant (not editing the default
 * syscfg) keeps the silicon-validated default image's board file byte-identical.
 *
 * The bridge has NO physical console -- this UART2 exists so the SDK console
 * glue LINKS; the bridge firmware never calls InitTerm()/Report().  The UART
 * sits on free pins (GPIO5/GPIO6, the LaunchPad XDS110 default) that do NOT
 * collide with the inter-chip SPI pads (GPIO16/27/28/29).
 *
 * MEASURED 2026-08-29: those pins are NOT routed to the debug probe on the
 * E1M-AEN801, so the "LaunchPad XDS110 default" does not carry over to this
 * SoM.  A probe build was made to open UART2_0 and write every housekeeping
 * tick; the firmware reported UART2_open() handle non-NULL, UART2_write()
 * returning UART2_STATUS_SUCCESS, and 188988 bytes accepted -- while BOTH
 * XDS110 COM ports (Class Auxiliary Data Port and Class Application/User
 * UART) received ZERO bytes across a full cold boot.  The UART works; the
 * wiring is absent.
 *
 * Consequences, so nobody re-runs this: there is no CC35 console on this SoM
 * (confirming metadata/e1m_modules/aen/inter-chip.tsv, which wires only SPI +
 * E_WIFI_NRST + WIFI_EN); the SDAA443 Network-Terminal/Calibrator path over
 * the "Class Application/User UART" is unavailable here; and the UART cannot
 * serve as an out-of-band read-back channel for the wedge probe.  All three
 * need a free E1M pad muxed as UART, or a board rev.
 *
 * THE DEDICATED LOGGER PIN IS ALSO UNROUTED (measured 2026-08-29).  CC35 pin
 * 38 / GPIO9 is TI's radio-firmware tracer output, and it sits next to SWDIO
 * (pin 40 / GPIO7) and SWCLK (pin 39 / GPIO8), which ARE wired to the XDS110 --
 * so it was worth checking whether the tracer reaches the probe even though the
 * application UART does not.  It does not: with BOTH XDS110 COM ports open
 * (Class Auxiliary Data Port and Class Application/User UART) across sustained
 * Wi-Fi and BLE activity -- two `wifi scan` runs returning APs at -45 dBm and a
 * `ble scan` returning devices, so the NWP was demonstrably busy -- both ports
 * received ZERO bytes.
 *
 * That closes the last host-side observability route on this SoM: no CC35
 * console (UART2 on GPIO5/GPIO6), no radio tracer (LOGGER on GPIO9), and no SWD
 * memory access (the DAP answers but exposes no MEM-AP on an activated part).
 * Radio observability stays at the one diagnostic byte the bridge reports.
 */

/* ======== Kernel ======== */
system.getScript("kernel_config_release.syscfg.js");

/* ======== FreeRTOS heap (SHIP-CRITICAL for the Wi-Fi build) ========
 * Bump the FreeRTOS heap to the network_terminal demo's 0x57000 (348 KB).  The
 * Wi-Fi host driver's InitHostDriver (run inside Wlan_Start) creates the
 * transport + FW-event THREADS and the RX/TX/control BUFFERS from the FreeRTOS
 * heap.  The kernel default heap is only 0x8000 (32 KB): those allocations fail,
 * so no event thread exists to signal init_device's fwEvent_Wait -> Wlan_Start
 * HANGS forever (bench-proven: GET_MAC's Wlan_Start never returned, the bridge
 * SPI stayed dead, ping_ok stuck 0 / reqhdr_rx=0x00000000).
 *
 * The demo uses 0x57000 (348 KB), but that is its NON-vendor example RAM map
 * (~509 KB DRAM).  Our VENDOR image is capped at DRAM 0x30000 (193 KB,
 * cc3501e_vendor.cmd, single region; heap_4 ucHeap is in .bss there -- no PSRAM
 * [unpopulated], no heap_5, can't span regions).  After ~31 KB non-heap .bss the
 * heap ceiling is ~154 KB, and the 8 KB bring-up/worker stack (src/main.c) takes
 * its share, so the largest heap that links is 0x22000 (136 KB).
 *
 * That is AMPLE for the GET_MAC milestone: bare Wlan_Start->cme_init+
 * InitHostDriver+fwEvent(RX_TX_BUFFER=13000) needs only ~40-60 KB of heap (no
 * lwIP/sockets/TLS), and Wlan_Get(WLAN_GET_MACADDRESS) just queries the CME
 * engine.  But the SDK's STA-WITH-SOCKETS floor is 0x42000 (264 KB) > the whole
 * 193 KB region, so full connect-STA/sockets does NOT fit this vendor image --
 * defer to a PSRAM HW rev or shrink the wifi-lib RX/TX/control buffers
 * (conf_bin/Kconfig).  (Default/radio-free build keeps the 32 KB default.) */
system.modules["/freertos/FreeRTOS"].$static.heapSize = 0x00046000; /* 280KB -- raised again (2026-07-05) from 264KB to unblock lwip_socket: at 264KB the
 * netconn recvmbox/sem alloc for lwip_socket() FAILED on the bench (sock_open -1), because after Wlan_Start (~136KB) + lwIP tcpip stack + wifi/hostap threads +
 * PSA/TLS the runtime free heap was below the netconn allocation size.  0x46000 is the DRAM CEILING for the -Ble build: the connectivity vendor map
 * DRAM_NON_SECURE = 0x7F24F (~520KB) and the -Ble .bss+heap footprint at 264KB used 0x79EFC (~487KB, only ~21KB free -- see the -Ble .map), so the non-heap
 * footprint is ~0x37EFC and the max heap that links is ~0x47353; 0x46000 keeps a ~5KB DRAM margin.  NOTE (DRAM-bound, flagged for the bench): with BLE in, the
 * heap can only grow ~16KB, which may be marginal for many concurrent sockets -- a WIFI-ONLY socket build frees NimBLE's .bss and allows a much larger heap
 * (~0x57000 per the wifi-only margin below), and the socket data path does not need BLE.  HISTORICAL (2026-06-23, 264KB): full STA CONNECT (host WPA/WPA3-SAE supplicant +
 * lwIP netif + PSA/TLS crypto) needs ~the SDK STA+sockets floor 0x42000, which 136KB STARVED (Wlan_Start + lwIP could not both allocate -> the worker HUNG: scan
 * -4 / READY stuck low / no connect event).  The old "193KB DRAM cap / WiFi+BLE can't coexist / 136KB max" note below is STALE: build_ti.ps1 links the 512KB
 * connectivity DRAM map (cc3501e_vendor.cmd DRAM_NON_SECURE = 0x7F24F ~520KB; the -Ble map showed ~152KB free at 136KB heap), so the heap was pinned low by THIS
 * syscfg line, not the region.  264KB fits Wi-Fi-only with wide margin (~84KB) and -Ble with ~24KB.  HISTORICAL (pre-512KB-map) note follows:
 * [stale] 136KB -- the VALIDATED WiFi GET_MAC/scan config (bench-proven cold: ping_ok climbs, mac_ok=1).
 * Wlan_Start's heap floor was pinned on silicon 2026-06-18 across four points: STARVES at 88KB/0x16000,
 * 106KB/0x1A000, 120KB/0x1E000 (all: ping_ok stuck at the gate, reqhdr_rx->0, mac timeout); WORKS at
 * 136KB/0x22000. So Wlan_Start needs ~128-136KB heap -- it is the HIF bring-up both WiFi GET_MAC AND BLE
 * (shared HIF) must run. Consequence (BLE feasibility, settled): heap ~130KB + ~48KB fixed WiFi/stack bss
 * leaves only ~15KB of the 193KB vendor DRAM for NimBLE (host+controller HCI >> 15KB even trimmed), and the
 * lwIP/hostap drop frees ~nothing (gc-sections already strips their pools to a few KB -- they are heap-not-bss).
 * => WiFi+BLE CANNOT coexist on this no-PSRAM rev; BLE needs the PSRAM HW rev (or a conf_bin RX/TX-buffer
 * shrink to lower this floor -- GUI INI-composer-gated). 136KB is the max heap that links in 0x30000 with the
 * 8KB bring-up stack. Full STA+sockets (264KB SDK floor) also doesn't fit -> same PSRAM rev. */

/* ======== Secure key store (HSM/PSA crypto) -> CryptoKeyKeyStore_PSA ========
 * Wlan_Start + Wlan_RoleUp(STA) bring up the WPA/TLS supplicant, which uses
 * the CC35xx HSM-backed PSA crypto + KeyStore.  That crypto stack's RAM
 * objects are SysConfig-GENERATED, not in any .a -- the linker reports them
 * as undefined when the archives alone are linked:
 *   volatileAllocBuffer / volatileAllocBufferSizeBytes, gl_PSA_Key,
 *   MBEDTLS_KEY_{VOLATILE,ASSET_STORE,PERSISTENT}_COUNT, FLASH_KEY_PERSISTENT_COUNT
 *     <- CryptoKeyKeyStore_PSACC35XX.Board.c (this module's generated Board.c)
 *   RNGXXF3HSM_returnBehavior
 *     <- the RNG module's Board.c (auto-forced by this module via
 *        Common.autoForceModules(["Board","Power","CryptoBoard","RNG"]))
 * Defaults match the SDK network_terminal demo syscfg (the authoritative
 * Wi-Fi+TLS recipe), which declares this exact module with no overrides. */
var CryptoKeyKeyStore_PSA = scripting.addModule("/ti/drivers/CryptoKeyKeyStore_PSA");

/* ======== SPI peripheral (slave) -> CONFIG_SPI_0 ========
 * VERBATIM from cc3501e_aen.syscfg -- see that file for the full bench HW
 * notes (crossed SoM data lines, CS->GPIO16 pull-low fix, 0x5A diag idle). */
var SPI  = scripting.addModule("/ti/drivers/SPI");
var spi0 = SPI.addInstance();
spi0.$name                = "CONFIG_SPI_0";
spi0.mode                 = "Four Pin CS Active Low";
spi0.duplex               = "Full";       /* both data lines (RX requests + TX replies) */
spi0.defaultTxBufferValue = "0xA5";       /* idle MISO = the 0xA5 SYNC marker (ALP_CC3501E_SYNC_IDLE):
                                           * the slave drives 0xA5 even BETWEEN armed transfers (callback
                                           * re-arm gap), so the host never catches a stray idle byte mid-
                                           * frame on cold first-contact (was 0x5A -> reqhdr_rx=0x..005A
                                           * leak -> cold byte-misalign). Ship value. */

spi0.spi.sclkPin.$assign = "GPIO27";  /* <- Alif SCLK/P14_6 (correctly wired) */
spi0.spi.picoPin.$assign = "GPIO29";  /* peripheral data IN  (needs Alif MOSI here -- HW cross) */
spi0.spi.pociPin.$assign = "GPIO28";  /* peripheral data OUT (needs Alif MISO here -- HW cross) */
spi0.spi.csnPin.$assign  = "GPIO16";  /* CS -> GPIO16 (only silicon-legal CS; pulled LOW to assert) */

/* SHIP-CRITICAL (host-DMA on channels 12/13 -- keep in sync with
 * cc3501e_aen.syscfg): the on-chip Wi-Fi/BLE radio is a SEPARATE subsystem (NWP)
 * from the AP M33 the bridge runs on, so its DMA ops do not block the AP CPU --
 * the bridge SPI callback keeps re-arming the hardware-SS0 phases while the radio
 * works.  What the TRM actually says: swru626 §11.3.1 is a table of PERIPHERAL
 * REQUEST INDICES -- "the list of peripherals and their index supported by each
 * DMA channel" -- NOT a map of channel ownership.  The indices are 0-3
 * UART0/UART1 RX/TX, 4-5 SPI0 RX/TX, 6-7 SPI1 RX/TX, 8-11 I2C0/I2C1 RX/TX, 12-13
 * SDMMC RX/TX, 14-15 SDIO RX/TX, 16-17 DCAN RX/TX, 18 ADC Read, 20 PDM Read,
 * 22-23 Wi-Fi/BLE Host Interface (HIF), 24-25 UART2 RX/TX (HIF is 22/23, not 11;
 * index 11 is I2C1 TX; there is no "TEMP" peripheral in that chapter).  §11.1
 * states the channels are "independently configured and operated" with "flexible
 * channel assignments": the TRM reserves NO channel to the radio and guarantees
 * no channel is free.
 *
 * Pinning the bridge SPI's RX DMA to ch12 and TX DMA to ch13 is therefore a BENCH
 * OBSERVATION of SDK behaviour, not a documented guarantee: on this SDK the radio
 * was never seen to remux 12/13, so the bridge drains/fills its FIFO autonomously
 * while Wlan_Start/scan/connect run.  (Earlier auto-assigned pins -- ch11, then
 * ch8/ch6 -- died the instant the radio re-pointed the shared mux; a non-DMA
 * polling path died too, preempted by the worker's Wlan_Start.  Pinning 12/13
 * avoids both failure modes.)  Re-verify on silicon after any SDK or
 * radio-firmware bump.
 *
 * SysConfig exposes no minDmaTransferSize property, so build_ti.ps1 patches the
 * GENERATED ti_drivers_config.c to 1024 unconditionally (a whole 516 B frame must
 * clear it for OTA update mode's polled slave).  That is inert here: the driver's
 * polling gate short-circuits on transferMode == SPI_MODE_BLOCKING, which the normal
 * callback/DMA bridge never is.  The bridge mode is a RUNTIME choice (a persisted
 * boot flag), not a build switch -- these DMA channel pins serve the NORMAL mode. */
spi0.spi.dmaRxChannel.$assign = "DMA_CH12";
spi0.spi.dmaTxChannel.$assign = "DMA_CH13";

/* ======== SPI controller (master) -> CONFIG_SPI_1 ========
 * SPI1 HOST PASSTHROUGH (protocol v6: CMD_SPI1_CONFIGURE/TRANSFER/RELEASE,
 * 0x55/0x56/0x57).  This is NOT a second bridge transport.  It is the E1M
 * CONNECTOR's SPI1 bus, which on E1M-AEN-2626-R2 lands on the CC3501E (U4) and
 * NOT on the Alif -- so the only way the host can drive that bus at all is by
 * relay: the CC35 is the SPI CONTROLLER and the host supplies the bytes.
 *
 *   connector E1     net              CC3501E pad  SPI1 function (mux)
 *   --------------   --------------   -----------  ----------------------
 *   AG10 SPI1_SCLK   WIFI_SPI1.SCK    GPIO_32      SPI1_CLK  (4)
 *   AG9  SPI1_MOSI   WIFI_SPI1.MOSI   GPIO_33      SPI1_MISO (4)  <- crossed
 *   AG8  SPI1_MISO   WIFI_SPI1.MISO   GPIO_34      SPI1_MOSI (4)  <- crossed
 *   AH9  SPI1_CS0    WIFI_SPI1.CS0    GPIO_31      SPI1_CS1  (4), GPIO-driven
 *   AH8  SPI1_CS1    WIFI_SPI1.CS1    GPIO_15      SPI1_CS2  (16), GPIO-driven
 *
 * The inter-chip bridge is a DIFFERENT bus -- CONFIG_SPI_0 above (GPIO16/27/
 * 28/29) plus the GPIO17 READY line.  Nothing in this block may touch those
 * five pads; re-muxing one kills the very link the host issues commands over.
 *
 * ============================ HARDWARE NOTE ============================
 * *** The SPI1 DATA LINES ARE CROSSED -- the same defect class as the SPI0
 * crossed-data note in cc3501e_aen.syscfg, on a different bus. ***  The CC35xx
 * silicon fixes which pad may carry which SPI1 data role (CC3551E.json
 * reverseMuxes, SysConfig 1.28.0 deviceData):
 *     SPI1_MOSI: GPIO13 / GPIO34 / GPIO6  (mux 4)  -- GPIO33 is NOT legal
 *     SPI1_MISO: GPIO15 / GPIO33 / GPIO5  (mux 4)  -- GPIO34 is NOT legal
 * but the netlist wires connector MOSI (AG9) to GPIO_33 and connector MISO
 * (AG8) to GPIO_34: exactly backwards.  The ONLY assignment SysConfig can
 * solve is the one below -- picoPin = GPIO34, pociPin = GPIO33 -- which means
 * the CC35 DRIVES the net labelled WIFI_SPI1.MISO and LISTENS on the net
 * labelled WIFI_SPI1.MOSI.  Both the CC35 pad roles and the connector pins are
 * silicon/PCB-fixed, so neither end can correct this in firmware, exactly as
 * on SPI0.
 *
 * Settle this against the netlist BEFORE trusting a bench capture: the bus
 * works as configured here only if the far-end device is wired to the swap
 * (its MOSI on AG8, its MISO on AG9).  Wired to the connector LABELS instead,
 * two push-pull outputs share one net and nothing drives the other -- RX reads
 * a constant idle level while the two drivers fight.  That contention is a
 * sustained short between two outputs: do not leave it clocking while you
 * debug it; the fix is an AG9<->AG8 cross or a carrier rev.
 * ======================================================================
 *
 * DECLARATION ORDER IS LOAD-BEARING.  SysConfig indexes SPI_config[] by
 * instance order, so CONFIG_SPI_0 == 0 holds only while spi0 is declared
 * FIRST.  Move this instance above it and the inter-chip transport's
 * SPI_open(CONFIG_SPI_0, ...) opens THIS controller instead: the bridge goes
 * silently dead, with no build error and no wrong pin in the generated file.
 *
 * Nothing here says "master".  Role and bit rate are RUNTIME choices in the
 * HAL -- SPI_open(CONFIG_SPI_1, SPI_CONTROLLER, SPI_MODE_BLOCKING) with
 * SPI_Params.bitRate taken from CMD_SPI1_CONFIGURE's freq_hz.  The divider
 * rounds, which is why the CONFIGURE reply reports the ACTUAL rate instead of
 * echoing the request.
 *
 * The instance is not pinned to a peripheral either, and does not need to be:
 * SPI0_CLK is legal only on GPIO17/GPIO27, so assigning sclkPin = GPIO32 --
 * an SPI1_CLK-only pad -- leaves the solver exactly one peripheral to pick.
 *
 * This instance exists in the Wi-Fi variant ONLY.  cc3501e_aen.syscfg (the
 * default/radio-free image) still has SPI_count == 1 and defines no
 * CONFIG_SPI_1 symbol at all, so HAL code naming it must be guarded or that
 * image stops compiling. */
var spi1 = SPI.addInstance();
spi1.$name = "CONFIG_SPI_1";

/* THREE PIN -- both chip-selects are driven by the HAL as plain GPIOs, and the
 * silicon forces that, it is not a preference.  SPIWFF3DMA carries ONE
 * csnPin/csnPinMux/csnSel per SPI_Config entry, and the two selects need
 * DIFFERENT muxes: GPIO31 is SPI1_CS1 at mux 4, GPIO15 is SPI1_CS2 at mux 16
 * (CC3551E.json).  One instance cannot hardware-frame both.  Nor can it switch
 * at runtime: SPIWFF3DMA_CMD_SET_CSN_PIN re-muxes the NEW pad with the OLD
 * csnPinMux, so a CS0->CS1 switch would apply mux 4 to GPIO15 -- which is
 * SPI1_MISO -- and hang a second data receiver on the bus.
 *
 * Two consequences, both bench-visible:
 *  - CS-to-first-clock setup is SCHEDULER-timed, not clock-edge-exact, because
 *    the HAL toggles the pad around the transfer.  A peripheral demanding
 *    sub-microsecond CS setup will not work here, and no protocol change fixes
 *    it; that ceiling is documented at the opcodes in the canonical header.
 *  - Three Pin also asks SysConfig for NO CS pin resource, which keeps the pin
 *    solver away from two pads that are already spoken for on this SoM but
 *    INVISIBLE to it, because neither has a SysConfig instance claiming it:
 *    GPIO17 (SPI1_CS3, mux 16) is the bridge READY line, and GPIO26
 *    (SPI1_CS2, mux 16) is the connector's IO20 (E1 pin K3 --
 *    metadata/e1m_modules/aen/from-cc3501e.tsv in alp-sdk), a general-purpose
 *    connector pin with no fixed function of its own.  A Four Pin instance
 *    with an unpinned CS could legally take either one.
 *
 * BENCH CHECK on the first SysConfig run -- nothing in CI runs SysConfig, so a
 * PR cannot catch this: read the CONFIG_SPI_1 entry of the generated
 * ti_drivers_config.c and confirm its .csnPin did not default onto GPIO17,
 * GPIO26, or any of GPIO15/31/32/33/34.  The SPI0 Three Pin experiment
 * (cc3501e_aen.syscfg) showed the driver falling back to a default CS0 pad
 * even with no CS requested. */
spi1.mode   = "Three Pin";
spi1.duplex = "Full";       /* the wire is always full-duplex; the protocol's
                             * NO_RX/NO_TX flags only drop a direction from the
                             * BRIDGE frame, they do not change the pins. */

/* Clocked out only if the HAL ever submits a transaction with txBuf == NULL.
 * 0xFF, not 0x00: on a SPI NOR flash 0xFF is the benign no-op byte while 0x00
 * is a valid opcode.  NOTE for the HAL: this is a BUILD constant, so the
 * protocol's per-transfer tx_fill CANNOT be honoured by passing txBuf = NULL --
 * the HAL has to fill a scratch buffer with tx_fill.  A bench capture showing
 * 0xFF on MOSI where the host asked for another fill is exactly that bug. */
spi1.defaultTxBufferValue = "0xFF";

/* The only silicon-legal mapping (see HARDWARE NOTE).  pico = what the
 * CONTROLLER drives, poci = what it samples. */
spi1.spi.sclkPin.$assign = "GPIO32";  /* <- connector AG10 SPI1_SCLK */
spi1.spi.picoPin.$assign = "GPIO34";  /* controller data OUT -- lands on the net
                                       * LABELLED WIFI_SPI1.MISO (AG8) */
spi1.spi.pociPin.$assign = "GPIO33";  /* controller data IN  -- lands on the net
                                       * LABELLED WIFI_SPI1.MOSI (AG9) */

/* CS0 (GPIO31) and CS1 (GPIO15) deliberately get NO pin resource here -- the
 * HAL owns them via GPIO_setConfig()/GPIO_write(), the same way the camera LDO
 * enables on GPIO_0/GPIO_1 are driven (both are GPIOWFF3_DO_NOT_CONFIG in the
 * generated table, and both are bench-PASS).  They must be configured as
 * outputs idling HIGH before the first transfer, and gpio_pad_reserved() in
 * hal/ti/cc3501e_hw_ti_gpio.c must refuse pads 15/31/32/33/34 -- otherwise a
 * host CMD_GPIO_CONFIGURE/WRITE re-muxes SCK or a data line out from under an
 * in-flight transfer, which is exactly why 16/27/28/29 are refused already.
 *
 * Host-facing cs=0 is device SPI1_CS1 and cs=1 is device SPI1_CS2: TI numbers
 * the device SIGNALS from 1 while the driver numbers SELECTS from 0 (spi0's
 * csnPin GPIO16 is SPI0_CS1 and generates .csnSel = SPI_CSSEL_CS0).  Keep the
 * host-facing names 0/1 -- they follow the CONNECTOR nets WIFI_SPI1.CS0/CS1. */

/* DMA channels, pinned for the same reason spi0 pins 12/13: on this SDK an
 * AUTO-assigned channel was observed being re-pointed by the radio (ch11, then
 * ch8/ch6, all died mid-transfer) while an explicitly pinned pair never was.
 * Both SPI instances may use DMA_CH0..DMA_CH13 (CC3551E.json DMA_SPI_1_RX/TX),
 * so this pair is the highest two that are neither the bridge's own 12/13 nor
 * any channel the radio was seen to steal.  Sharing a channel with
 * CONFIG_SPI_0 would BE the wedge, so never "simplify" these back to 12/13.
 *
 * ASSUMPTION, NOT A BENCH RESULT: the 12/13 observation does not transfer to
 * 9/10.  Scope it under radio load (a wifi scan concurrent with a 4088-byte
 * transfer) before trusting it.  If the radio does steal them the failure is
 * loud and contained: SPI_transfer() returns false, the passthrough maps that
 * to RESP_ERR_STATE (a terminal reject, not a retry), and the inter-chip
 * bridge on 12/13 is untouched.  The fallback is the polling path --
 * build_ti.ps1 rewrites .minDmaTransferSize to 1024 for EVERY instance in the
 * generated file, so a SPI_MODE_BLOCKING controller transfer shorter than 1024
 * bytes skips DMA entirely; a smaller host chunk therefore trades throughput
 * for independence from the DMA mux.  (Side note for whoever next touches that
 * script: its post-condition greps for a single ".minDmaTransferSize = 1024,",
 * so with two instances it no longer proves full coverage.) */
spi1.spi.dmaRxChannel.$assign = "DMA_CH9";
spi1.spi.dmaTxChannel.$assign = "DMA_CH10";

/* ======== UART2 (console glue) -> CONFIG_UART2_0 ========
 * Required only by the Wi-Fi host integration's uart_term.c/syslog.c so the
 * link resolves; unused at runtime on the headless bridge.  Pins GPIO5/GPIO6
 * (XDS110 default) are clear of the SPI pads. */
/* ======== ADC: internal temperature sensor (errata RADIO_01, #18) ========
 *
 * Advisory RADIO_01 (SWRZ167) says the RF core does not limit radio activity at
 * 105C > TA > 85C, and the workaround is to limit TX or disable the radios above
 * 85C.  Neither half is implemented, and the reason is that nothing in this
 * firmware could read the die temperature at all.  This instantiates the channel
 * so raw codes can be captured; it does NOT implement a trip.
 *
 * `internalSignal = "Temperature Channel"` is the supported pinless path:
 * ADCWFF3Channel.syscfg.js's pinmuxRequirements() returns [] whenever
 * internalSignal != "None", so this consumes NO pad and cannot collide with the
 * inter-chip SPI pads (GPIO16/27/28/29) or the camera LDO enables on
 * GPIO_0/GPIO_1.
 *
 * DELIBERATELY NO TRIP THRESHOLD.  TI has not published a transfer function,
 * gain/offset trim or OTP location for internal channel 11 in SWRU626, SWRS343A,
 * SLUUDH6 or SDAA244A, so a raw code cannot be converted to degrees C.  A
 * threshold guessed from an uncalibrated code fails in BOTH directions: set too
 * high it does not protect against a documented device-damage condition, set too
 * low it silently disables Wi-Fi and BLE on a healthy unit in an enclosure.  The
 * raw code is exposed to the bench probe only, to characterise the channel and
 * to give TI a concrete anchor for the transfer-function question.
 */
var ADC   = scripting.addModule("/ti/drivers/ADC");
var adc0  = ADC.addInstance();
adc0.$name                        = "CONFIG_ADC_TEMP";
adc0.adcChannel.$name             = "CONFIG_ADC_TEMP_CHANNEL";
adc0.adcChannel.internalSignal    = "Temperature Channel";
adc0.adcChannel.referenceSource   = "ADCWFF3_INTERNAL_REFERENCE";

var UART2 = scripting.addModule("/ti/drivers/UART2");
var uart0 = UART2.addInstance();
uart0.$name = "CONFIG_UART2_0";
uart0.uart.txPin.$assign = "GPIO5";
uart0.uart.rxPin.$assign = "GPIO6";
