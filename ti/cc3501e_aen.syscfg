/*
 * Copyright 2026 Alp Lab AB
 * SPDX-License-Identifier: Apache-2.0
 */
// @cliArgs --board /ti/boards/LP_EM_CC35X1 --rtos freertos

/*
 * cc3501e-bridge ti-build board file (SysConfig input).
 *
 * Generates CONFIG_SPI_0 -- the inter-chip SPI-peripheral (slave) the
 * firmware opens in hal/ti/transport_hw_ti_spi.c (SPI_open(CONFIG_SPI_0,
 * SPI_PERIPHERAL, SPI_MODE_CALLBACK)).  Based on the SDK's
 * drivers/spiperipheral demo (examples/rtos/LP_EM_CC35X1/drivers/spiperipheral).
 *
 * AEN INTER-CHIP PINOUT (bench, 2026-06-16).  The on-module link wires the
 * CC3501E (U4, BDE-BW35N) SPI0 to the Alif (U6) SPI1, traced from the SoM
 * netlist (som_pinmap.csv) + metadata/e1m_modules/aen/inter-chip.tsv:
 *
 *   CC3501E pin   net               Alif pin (SPI1, master)
 *   -----------   ---------------   -----------------------
 *   GPIO_27       WIFI_SPI0.SCK     P14_6  SPI1_SCLK_C   -> SCLK
 *   GPIO_28       WIFI_SPI0.MOSI    P14_5  SPI1_MOSI_C   -> CC3501E data IN  (PICO)
	 *   GPIO_29       WIFI_SPI0.MISO    P14_4  SPI1_MISO_C   -> CC3501E data OUT (POCI)
	 *   GPIO_16       WIFI_SPI0.CSN     P14_7  SPI1_SS0_C    -> hardware SS0
	 *   GPIO_17       WIFI_SPI0.READY   P2_6                 -> phase-ready GPIO
 *
 * ============================ HARDWARE NOTE ============================
 * The CC35xx silicon FIXES the SPI0 data roles (confirmed via SysConfig
 * valid-pin sets):
 *     PICO (peripheral data IN)  = GPIO29  (GPIO28 is NOT a valid PICO pin)
 *     POCI (peripheral data OUT) = GPIO28
 * This file therefore assigns the only silicon-legal mapping.  Neither side
 * can change it: both Alif pads (SPI1_MOSI_C / SPI1_MISO_C) and both CC35xx
 * data roles are fixed.  (It happens to equal the LaunchPad LP_SPI0_BUS
 * default.)
 *
 * CORRECTED for board rev 2626-R2 (alp-sdk#1807).  This note used to open
 * "*** SoM rev BUG: the SPI0 data lines are CROSSED ***" and claim the module
 * wires Alif P14_5 MOSI --R48-- GPIO28 and P14_4 MISO --R62-- GPIO29, i.e.
 * master output onto the slave's output.  It then told the reader the link
 * "needs a HARDWARE fix (cross the two data nets)".
 *
 * That is wrong for R2, and it is wrong in the direction that costs hardware:
 * the E1M-AEN-2626-R2 module netlist routes P14_5 through R62 to GPIO29 and
 * P14_4 through R48 to GPIO28 -- exactly the pairing the silicon requires, and
 * exactly what this file already assigns.  R2 is correct as designed.  Acting
 * on the old note and "crossing" the data nets on an R2 board would CREATE the
 * contention it warned about.  Note also that the two resistor designators
 * were paired the opposite way round from the netlist.
 *
 * SCOPE.  The above is about R2 as designed, NOT about any particular physical
 * module.  No r1 module netlist exists, so how an r1 board routes these two
 * nets is not established anywhere -- and r1 units are known to carry reworks
 * on other nets (the CS and READY lines).  Read the module's own revision
 * before deciding whether any rework applies, and do not remove one on the
 * strength of this note.
 * ======================================================================
 *
	 * Hardware-framed SPI: the Alif dwc-ssi master drives SS0 per protocol phase,
	 * and GPIO17 reports READY once the slave has re-armed.  SysConfig must stay in
	 * Four Pin CS Active Low mode so the TI SPI-peripheral driver observes a CSN
	 * resource; do not revert this board file to Three Pin mode.
 */

/* ======== Kernel ======== */
system.getScript("kernel_config_release.syscfg.js");

/* ======== SPI peripheral (slave) -> CONFIG_SPI_0 ======== */
var SPI  = scripting.addModule("/ti/drivers/SPI");
var spi0 = SPI.addInstance();
spi0.$name                = "CONFIG_SPI_0";
/*
	 * BENCH FIX 2026-06-17, kept for current hardware-SS0 framing: the CC35 SPI
	 * *peripheral* needs its CS (ss_in_n) resource asserted to shift + drive POCI.
	 * In Three Pin mode the driver still left a default CS0 on GPIO26 configured
	 * as a floating input -> slave never selected -> POCI high-Z (scope: flat
	 * ~1V), ping_ok=0. GPIO26 is ALSO the SoM's SDIO_MUX_EN (74LVC157 /E) so it
	 * can't be used. Fix: route the CS resource to GPIO16, the CC35-side CSN net
	 * paired with the Alif hardware SS0 transfer framing.
 */
spi0.mode                 = "Four Pin CS Active Low";
spi0.duplex               = "Full";       /* both data lines (RX requests + TX replies) */
spi0.defaultTxBufferValue = "0xA5";       /* idle MISO = the 0xA5 SYNC marker (ALP_CC3501E_SYNC_IDLE) so the
                                           * slave drives 0xA5 even BETWEEN armed transfers (callback re-arm
                                           * gap) -- the host's 0xA5 sync then never catches a stray idle byte
                                           * mid-frame on cold first-contact. Ship value (was bench-diag 0x5A,
                                           * which leaked into reqhdr_rx as 0x..005A and cold-byte-misaligned). */

/* Silicon-legal pads (see HARDWARE NOTE).  The pin resources live under the
 * instance's `spi` peripheral group; $assign uses the device pad names. */
spi0.spi.sclkPin.$assign = "GPIO27";  /* <- Alif SCLK/P14_6 (correctly wired) */
spi0.spi.picoPin.$assign = "GPIO29";  /* peripheral data IN  <- Alif MOSI/P14_5 via R62 (R2) */
spi0.spi.pociPin.$assign = "GPIO28";  /* peripheral data OUT -> Alif MISO/P14_4 via R48 (R2) */
spi0.spi.csnPin.$assign  = "GPIO16";  /* CSN resource paired with Alif SPI1_SS0_C; GPIO17 is READY. */

/* host-DMA on channels 12/13 (SHIP-CRITICAL -- keep in sync with
 * cc3501e_aen_wifi.syscfg).  The transport opens the slave SPI_MODE_CALLBACK so
 * the driver DMAs the FIFO.  What the TRM actually says: swru626 §11.3.1 is a
 * table of PERIPHERAL REQUEST INDICES -- "the list of peripherals and their
 * index supported by each DMA channel" -- NOT a map of channel ownership.  The
 * indices are 0-3 UART0/UART1 RX/TX, 4-5 SPI0 RX/TX, 6-7 SPI1 RX/TX, 8-11
 * I2C0/I2C1 RX/TX, 12-13 SDMMC RX/TX, 14-15 SDIO RX/TX, 16-17 DCAN RX/TX,
 * 18 ADC Read, 20 PDM Read, 22-23 Wi-Fi/BLE Host Interface (HIF), 24-25 UART2
 * RX/TX (HIF is 22/23, not 11; index 11 is I2C1 TX; there is no "TEMP"
 * peripheral in that chapter).  §11.1 states the channels are "independently
 * configured and operated" with "flexible channel assignments": the TRM reserves
 * NO channel to the radio and guarantees no channel is free.
 *
 * So pinning RX DMA to ch12 and TX DMA to ch13 rests on a BENCH OBSERVATION of
 * SDK behaviour -- on this SDK the radio's Wlan_Start/scan/connect were never
 * seen to remux 12/13, while auto-assigned channels were stolen -- and NOT on a
 * documented guarantee.  Re-verify on silicon after any SDK or radio-firmware
 * bump.  The default/radio-free build matches the Wi-Fi build so both run the
 * one CALLBACK/DMA transport. */
spi0.spi.dmaRxChannel.$assign = "DMA_CH12";
spi0.spi.dmaTxChannel.$assign = "DMA_CH13";
